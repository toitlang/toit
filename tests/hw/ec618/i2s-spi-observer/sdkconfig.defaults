## tests/hw/ec618/i2s-spi-observer/sdkconfig.defaults
```kconfig
CONFIG_ESP_CONSOLE_UART_DEFAULT=y
CONFIG_ESP_CONSOLE_UART_BAUDRATE=115200
CONFIG_LOG_DEFAULT_LEVEL_WARN=y
CONFIG_ESP_MAIN_TASK_STACK_SIZE=4096
CONFIG_ESPTOOLPY_FLASHSIZE_4MB=y

CONFIG_SPIRAM=y
CONFIG_SPIRAM_MODE_OCT=y
CONFIG_SPIRAM_SPEED_40M=y
CONFIG_SPIRAM_IGNORE_NOTFOUND=n
CONFIG_SPIRAM_USE_CAPS_ALLOC=y

CONFIG_ESP_DEFAULT_CPU_FREQ_MHZ_240=y

CONFIG_I2S_ISR_IRAM_SAFE=y

CONFIG_PCNT_ISR_IRAM_SAFE=y
CONFIG_PCNT_CTRL_FUNC_IN_IRAM=y
```

## tests/hw/esp32h2/wiring-fixture/sdkconfig.defaults
```kconfig
CONFIG_ESPTOOLPY_FLASHSIZE_4MB=y
CONFIG_LOG_DEFAULT_LEVEL_ERROR=y
CONFIG_BOOTLOADER_LOG_LEVEL_ERROR=y
CONFIG_ESP_CONSOLE_UART_DEFAULT=y
```

## tests/hw/nrf5340/ble-connect-esp32/sdkconfig.defaults
```kconfig
CONFIG_BT_ENABLED=y
CONFIG_BT_BLUEDROID_ENABLED=y
CONFIG_BT_NIMBLE_ENABLED=n
CONFIG_BT_CLASSIC_ENABLED=n
CONFIG_BT_BLE_ENABLED=y
CONFIG_BT_BLE_42_FEATURES_SUPPORTED=y
CONFIG_BT_BLE_50_FEATURES_SUPPORTED=n
CONFIG_ESPTOOLPY_FLASHMODE_DIO=y
CONFIG_ESPTOOLPY_FLASHSIZE_4MB=y
CONFIG_PARTITION_TABLE_SINGLE_APP=y
```

## toolchains/zephyr/Kconfig
```kconfig
# Copyright (C) 2026 Toit contributors.
# Use of this source code is governed by the LGPL-2.1 license in LICENSE.
mainmenu "Toit on Zephyr"

config TOIT_CRYPTO
	bool "Toit cryptographic primitives"
	default y
	help
	  Required for the UUIDs used by the storage service.

config TOIT_CRYPTO_EXTRA
	bool "Additional Toit cryptographic primitives"
	depends on TOIT_CRYPTO
	help
	  Enables SipHash and Blake2s. Increases firmware size. Asynchronous RSA
	  key generation is not available on Zephyr.

config TOIT_REBOOT_ON_FATAL_ERROR
	bool "Reboot after a native fatal error"
	depends on REBOOT
	default y
	help
	  Reset after a kernel panic, CPU exception, or C abort. Disable this
	  to retain Zephyr's halt-on-fault policy while debugging.

config TOIT_PSA_CRYPTO
	bool "Provide Zephyr PSA Crypto through Toit's Mbed TLS library"
	depends on PSA_CRYPTO_PROVIDER_CUSTOM
	select PSA_CRYPTO_CLIENT
	help
	  Shares one Mbed TLS implementation and configuration between the VM
	  and Zephyr. Enables the volatile AES and P-256 operations needed by
	  Bluetooth SMP. This does not provide persistent Bluetooth bond storage.

config TOIT_BLE_SECURITY
	bool "Toit secure BLE connections"
	depends on BT_SMP && BT_SETTINGS && TOIT_PSA_CRYPTO
	select BT_BONDABLE_PER_CONNECTION
	select BT_SMP_APP_PAIRING_ACCEPT
	help
	  Enables secure central connections and peripheral pairing using LE Secure
	  Connections Just Works. Bonds use the Bluetooth settings backend. Passkey,
	  numeric comparison and OOB APIs are not available.

source "Kconfig.zephyr"
```

## toolchains/zephyr/boards/ebyte/e83_2g4m03s_tb/Kconfig.e83_2g4m03s_tb
```kconfig
# Copyright (C) 2026 Toit contributors.
# SPDX-License-Identifier: Apache-2.0
config BOARD_E83_2G4M03S_TB
  select SOC_NRF5340_CPUAPP_QKAA if BOARD_E83_2G4M03S_TB_NRF5340_CPUAPP
  select SOC_NRF5340_CPUNET_QKAA if BOARD_E83_2G4M03S_TB_NRF5340_CPUNET
```

## toolchains/zephyr/boards/ebyte/e83_2g4m03s_tb/board.yml
```yaml
# Copyright (C) 2026 Toit contributors.
# SPDX-License-Identifier: Apache-2.0
board:
  name: e83_2g4m03s_tb
  full_name: Ebyte E83-2G4M03S-TB
  vendor: ebyte
  socs:
  - name: nrf5340
```

## toolchains/zephyr/dts/bindings/misc/toit,platform.yaml
```yaml
# Copyright (C) 2026 Toit contributors.
# SPDX-License-Identifier: Apache-2.0
compatible: "toit,platform"
description: Toit GPIO numbering and board pin restrictions
include: base.yaml
properties:
  gpio-ports:
    type: phandles
    required: true
    description: Ordered controllers; Toit pin number is 32 * index + pin.
  reserved-pins:
    type: array
    required: true
    description: Toit pin numbers requiring explicit allow-restricted permission.
  uart-ports:
    type: phandles
    description: UART controllers available to Toit, excluding the console.
  i2c-ports:
    type: phandles
    description: I2C controllers available to Toit, without shared UART/SPI instances.
  spi-ports:
    type: phandles
    description: SPI controllers available to Toit, without shared UART/I2C instances.
  adc-port:
    type: phandle
    description: ADC controller available to Toit.
  pwm-ports:
    type: phandles
    description: Nordic PWM controllers available to Toit; four channels per controller.
  adc-pins:
    type: array
    description: Toit GPIO numbers with analog inputs, paired with adc-inputs.
  adc-inputs:
    type: array
    description: Positive ADC input selectors corresponding to adc-pins.
  watchdog-port:
    type: phandle
    description: Application-controlled watchdog, independent of VM scheduling.
  storage-partition:
    type: phandle
    description: Internal memory-mapped flash storage, including two recovery journal pages.
```

## toolchains/zephyr/dts/bindings/rng/nordic,nrf-cc312-rng.yaml
```yaml
# Copyright (C) 2026 Toit contributors.
# SPDX-License-Identifier: Apache-2.0
description: nRF5340 CryptoCell 312 entropy collector
compatible: "nordic,nrf-cc312-rng"
include: base.yaml
```
