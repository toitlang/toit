## toolchains/idf/components/toit/Kconfig
```kconfig
menu "Toit"
    config TOIT_WIFI_SSID
        string "WiFi SSID"
        default ""
        depends on TOIT_ENABLE_WIFI
        help
            SSID (network name) for the example to connect to.

    config TOIT_WIFI_PASSWORD
        string "WiFi Password"
        default ""
        depends on TOIT_ENABLE_WIFI
        help
            WiFi password (WPA or WPA2) for the example to use.

    config TOIT_ENTRY_POINT
        string "Entry point"
        default ""
        help
            The toit entry point of custom toit program, for example examples/hello.toit.

    config TOIT_ENTRY_POINT_PROJECT_ROOT
        string "Entry point project root"
        default ""
        help
            Project root of the entry point toit program, if it includes external packages this is needed.

    config TOIT_ENTRY_POINT_ASSETS_FILE
        string "Entry point assets"
        default ""
        help
            An optional assets file to add to the entry point. The file is assumed to be named with an extension of json
            and the base name of the file becomes the name of the assets. The asset will be encoded as ubjson.
            As an example 'config.json' would become the config asset.

    config TOIT_BYTE_DISPLAY
        bool "Include primitives for byte-oriented (true-color or 256-shade gray) displays"
        default "y"

    config TOIT_BIT_DISPLAY
        bool "Include primitives for bit-oriented (2-color, 3-color, 4-shades) displays"
        default "y"

    config TOIT_FONT
        bool "Include primitives for font rendering"
        default "y"
        help
            If selected the font rendering primitives will be included in the
            Toit binary.  If this is selected you would normally want to also
            select either TOIT_BYTE_DISPLAY or TOIT_BIT_DISPLAY, otherwise you
            can only query font metrics, but not actually render characters.

    config TOIT_FATFS
        bool "Include primitives for the FAT filesystem"
        default "y"
        help
            If selected, embedded platforms will include the FAT filesystem
            primitives.

    config TOIT_ZLIB_RLE
        bool "Include primitives for zlib run-length encoding in native code"
        default "y"
        help
            If selected, embedded platforms will include code for run-length
            encoding.  It is available with `import zlib show
            RunLengthZlibEncoder`.

            This option takes about 1600 bytes of flash on ESP32 Xtensa.

    config TOIT_FULL_ZLIB
        bool "Include primitives for zlib compression/decompression in native code"
        default "n"
        help
            If selected, embedded platforms will include code for compressing
            and decompressing.  It is based on the MiniZ library.  It is
            available with `import zlib show Encoder Decoder`.

            Note that decompressing needs a contiguous
            32k buffer, so for systems without SPIRAM this is unlikely to work
            well.

            This option takes about 16k of flash on ESP32 Xtensa.

            As an alternative there is a pure Toit implementation of zlib
            decompression in the Toit standard library.  Use
            `import zlib show BufferingInflater CopyingInflater` to get
            access to this implementation.  The pure Toit version is slower,
            but always available, and does not suffer from fragmentation
            issues when allocating buffer space.

            There are also simple Toit implementations of zlib compression.
            These do not deliver large compression, but generate data streams
            compatible with zlib compression, eg for browsers that insist on
            getting zlib compressed data.

            Use `import zlib show UncompressedZlibEncoder` to
            get access to the uncompressed zlib-compatible encoder.

            Use `import zlib show RunLengthZlibEncoder` to
            get access to a zlib-compatible encoder that does only run-length
            encoding. This requires the TOIT_ZLIB_RLE option to be selected.

    config TOIT_AUDIO
        bool "Include common packed-PCM audio primitives"
        default "n"
        help
            If selected, embedded platforms include compact native primitives
            for packed PCM conversion, channel extraction and decimation,
            mixing, reductions, and framed energy extraction.

            Disable this option when the firmware does not process audio to
            save flash space.

    config TOIT_AUDIO_EXTRA
        bool "Include audio DSP primitives"
        default "n"
        depends on TOIT_AUDIO
        help
            If selected, embedded platforms also include Q15 real FFT and
            GCC-PHAT delay estimation, normalized sliding correlation,
            Goertzel-bank, FIR and biquad filters, and linear-resampling
            primitives. These are useful for spectral analysis and streaming
            DSP, but are less commonly needed than the basic packed-PCM
            operations.

    config TOIT_AUDIO_FLOAT_FFT
        bool "Include float32 complex FFT primitives"
        default "n"
        depends on TOIT_AUDIO_EXTRA
        help
            If selected, embedded platforms also include complex float32 FFT,
            multiplication, magnitude, and power primitives. Float32 provides
            convenient scaling and precision for convolution and spectral
            processing, but requires more flash, RAM, and CPU on targets
            without a floating-point unit.

    config TOIT_REPORT_UART_DATA_LOSS
        bool "Report when UART data is lost"
        default "y"
        help
            If selected, the UART driver will report when data is lost due to
            the UART buffer being full.

            This slows down the UART driver slightly when it is already under
            pressure and has no purpose if the device's serial console is not
            monitored.

    config TOIT_REPORT_I2S_DATA_LOSS
        bool "Report when I2S data is lost"
        default "y"
        help
            If selected, the I2S driver will report when data is lost due to
            the buffers being full.

            This slows down the I2S driver slightly when it is already under
            pressure and has no purpose if the device's serial console is not
            monitored.

    menu "Advanced setup"
        config TOIT_INTERPRETER_IN_IRAM
            bool "Run interpreter from IRAM"
            default "y"
            help
                If selected, the interpreter will be placed in IRAM. This will
                increase the performance dramatically, but reduce the amount of
                free IRAM by about 13k.  Set to "n" if you cannot link because
                of exhausted IRAM.
                Only the C++ interpreter of format 1 (TOIT_CXX_INTERPRETER);
                the verified core's loop has TOIT_VERIFIED_CORE_LOOP_IN_IRAM.

        config TOIT_INTERPRETER_HELPERS_IN_IRAM
            bool "Run interpreter helper code from IRAM"
            default "y"
            help
                If selected, the interpreter helper functions will be placed in
                IRAM. This will increase the performance slightly, but reduce
                the amount of free IRAM by about 2k.  Set to "n" if you cannot
                link because of exhausted IRAM.
                Disabling this option also disables the interpreter's native
                hash-lookup fast path, using the Toit implementation instead.

        config TOIT_CRYPTO
            boolean "Enable crypto functions on ESP32"
            default "y"
            help
                This includes certificate and TLS support.

        config TOIT_CRYPTO_EXTRA
            boolean "Enable extra crypto functions on ESP32"
            default "n"
            help
                This includes crypto and checksum algorithms that are not
                needed for TLS.

        config TOIT_ENABLE_IP
            boolean "Enable native lwIP stack on ESP32"
            default "y"
            depends on LWIP_ENABLE && ESP_NETIF_TCPIP_LWIP
            help
                Includes the lwIP event source and the native TCP/UDP
                primitives in the Toit binary. Disabling this option alone
                does not remove ESP-IDF's lwIP component from the build; also
                disable LWIP_ENABLE for a build without lwIP.

        config TOIT_ENABLE_ETHERNET
            boolean "Enable Ethernet drivers on ESP32"
            default "y"
            depends on TOIT_ENABLE_IP
            help
                Ethernet support in the toit binary.

        config TOIT_ENABLE_WIFI
            boolean "Enable WIFI on ESP32"
            default "y"
            depends on TOIT_ENABLE_IP
            help
                WIFI support in the Toit binary.

        config TOIT_ENABLE_ESPNOW
            boolean "Enable ESP-Now on ESP32"
            default "y"
            help
                ESP-Now support in the Toit binary.

        config TOIT_ENABLE_I2C_TARGET
            boolean "Enable I2C target support on ESP32"
            default "y"
            depends on SOC_I2C_SUPPORT_SLAVE
            select I2C_ENABLE_SLAVE_DRIVER_VERSION_2
            help
                I2C target and register-target support in the Toit binary.

                Disable this option to reduce firmware size when only I2C
                controller functionality is needed.

        config TOIT_ENABLE_SPI_TARGET
            boolean "Enable SPI target support on ESP32"
            default "y"
            help
                SPI target support in the Toit binary.

                Disable this option to reduce firmware size when only SPI
                controller functionality is needed.

        config TOIT_ENABLE_SPI_BUFFER_TARGET
            boolean "Enable buffered SPI target support on ESP32"
            default "y"
            depends on TOIT_ENABLE_SPI_TARGET
            help
                Autonomous buffered SPI target support in the Toit binary.

                Disable this option to reduce firmware size while retaining
                the transaction-at-a-time SPI target.

        config TOIT_SPIRAM_HEAP
            boolean "Enable Toit heap in SPIRAM"
            default "y"
            depends on SPIRAM_USE_CAPS_ALLOC || SPIRAM_USE_MALLOC
            help
                Enables the possibility of allocating Toit heap in the SPIRAM.

        config TOIT_SYSTEM_SOURCE
            string "Toit source file for system"
            default "system/extensions/esp32/boot.toit"
            help
                The Toit source file used to compile the system snapshot. The system is responsible for bringing up
                basic Toit services. The file should be absolute, relative to the project dir or relative to
                the Toit root dir (resolved in that order).

        config TOIT_SYSTEM_SOURCE_PROJECT_ROOT
            string "Project root for system source"
            default "system"
            help
                The project root for the system source file.

        config RODATA_PADDING
            int "Add this much padding to the drom/rodata section before the MMU starts moving data around"
            default 2097152
            range 0 8388609
            help
                Adds padding to the DROM data, so that there is a gap between the end of the DROM and the start of
                bss/data sections. This enables the DROM to be rewritten by an outside entity, as long as the DROM
                section does not increase more than this padding.

    endmenu

    config TOIT_VERIFIED_CORE
        bool "Verified format-2 core and verifier (Rust) for untrusted containers"
        default n
        depends on IDF_TARGET_ESP32C6 || IDF_TARGET_ESP32H2 || IDF_TARGET_ESP32 || IDF_TARGET_ESP32S3
        help
            Links the Verus-verified interpreter core and the format-2 verifier
            (verified/vmverify, a no_std Rust static library built with cargo)
            into the firmware, so that format-2 programs run on the core and
            untrusted containers can be verified at install time.
            RISC-V parts with the A extension (ESP32-C6, H2) need
            `rustup target add riscv32imac-unknown-none-elf`; the classic
            ESP32 (Xtensa) needs the esp-rs toolchain (`espup install`,
            cargo +esp; verified/XTENSA-RUST-FIXES.md). The ESP32-C3
            (rv32imc) lacks the atomics the Rust alloc library needs; the
            S3 uses the same fork (xtensa-esp32s3-none-elf); the S2 is not
            brought up (docs/format2-migration.md, "Devices").

    config TOIT_BYTECODE_FORMAT_2
        bool "Bytecode format 2 for the system and the bundled containers"
        default y
        depends on TOIT_VERIFIED_CORE
        help
            Compiles the system snapshot and the entry program in bytecode
            format 2 (trusted: with the unchecked twins and the built-ins),
            which run on the verified core, and records in the envelope that
            the firmware runs format 2 (`toit tool firmware container
            install` checks containers against it). If not selected, the
            firmware's own programs are format 1 and run on the C++
            interpreter.

    config TOIT_CXX_INTERPRETER
        bool "Link the C++ interpreter for format-1 programs" if TOIT_BYTECODE_FORMAT_2
        default y
        help
            The C++ interpreter (src/interpreter_run.cc and its method entry
            table) runs format-1 programs. A firmware whose programs are all
            format 2 does not need it: deselecting it saves flash and the
            interpreter's IRAM, and the firmware then refuses format-1
            programs. Always linked if the firmware's programs are format 1.

    config TOIT_VERIFIED_CORE_VERIFIER
        bool "Link the verifier for untrusted containers"
        default y
        depends on TOIT_VERIFIED_CORE
        help
            The format-2 verifier checks untrusted containers with their
            shipped certificates when they are installed. Firmware that never
            installs untrusted containers (all its programs are first-party
            and run as trusted) can leave it out to save about 27 KB of flash
            on the classic ESP32; every untrusted install is then rejected.

    config TOIT_VERIFIED_CORE_OPT_LEVEL
        string "Rust opt-level of the verified core (3, s or z)"
        default "s" if IDF_TARGET_ARCH_XTENSA
        default "3"
        depends on TOIT_VERIFIED_CORE
        help
            On Xtensa the run loop is optimized for speed whatever the level
            (`optimize(speed)`, step.rs, with the esp toolchain's nightly
            feature); "s" makes the rest of the core (cold paths, primitives)
            smaller: on the classic ESP32 4.3 KB less flash and, under QEMU,
            1 to 4 percent fewer instructions than "3". The RISC-V targets
            build with the stable toolchain, without the attribute: "s" there
            costs 11 to 15 percent in the run loop.

    config TOIT_VERIFIED_CORE_VERIFIER_OPT_LEVEL
        string "Rust opt-level of the install-time verifier (empty: z)"
        default ""
        depends on TOIT_VERIFIED_CORE_VERIFIER
        help
            The verifier (and the spec functions it runs) is compiled for
            size (opt-level z, verified/vmverify/staticlib/Cargo.toml);
            3 or s here trade flash for install time
            (docs/format2-migration.md, "Devices: hardware results").

    config TOIT_VERIFIED_CORE_LOOP_IN_IRAM
        bool "Run the verified core's loop from IRAM"
        default y if !TOIT_CXX_INTERPRETER
        depends on TOIT_VERIFIED_CORE
        help
            Places the core's run loop (step::run_loop: the dispatch and the
            handlers of the frequent opcodes, 12.2 KB on the classic ESP32;
            the rare opcodes and every slow path are out of line in
            step::step_cold and step::slow, in flash) in IRAM and its jump
            table in DRAM. Running it from flash thrashes the flash cache on
            real hardware: on the classic ESP32 json, map/set and string
            code ran 3.5-5x slower from flash than from IRAM, on the
            ESP32-C6 1.4-1.5x (docs/format2-migration.md, "Devices: hardware
            results"). On the C6 it costs 12 KB of heap (was 22 KB before
            the split). The classic ESP32 with ESP_WIFI_RX_IRAM_OPT on
            misses by 0.4 KB (split loop plus the hot C++ functions, V2_HOT);
            without it 17.7 KB of IRAM stay free next to the loop and the
            default TOIT_VERIFIED_CORE_IRAM_FUNCTIONS, enough for the cold
            part too (step::step_cold, step::slow_body: 11.7 KB). So it
            needs
                # CONFIG_ESP_WIFI_RX_IRAM_OPT is not set
                CONFIG_HEAP_PLACE_FUNCTION_INTO_FLASH=y
                CONFIG_RINGBUF_PLACE_FUNCTIONS_INTO_FLASH=y
            in its sdkconfig (otherwise IRAM overflows at link time).

    config TOIT_VERIFIED_CORE_IRAM_FUNCTIONS
        string "More functions of the verified core for IRAM"
        # The classic ESP32 (with ESP_WIFI_RX_IRAM_OPT off, see
        # TOIT_VERIFIED_CORE_LOOP_IN_IRAM): the most samples per byte first,
        # then the loop's cold part (slow, step_cold, slow_body: 11.7 KB);
        # 5.7 KB of IRAM stay free.
        default "9rnonlocal8op_try_v,toit_v2_run,4room15ensure_room_all,7rarrays15cxx_primitive_v,7machine3run,5prims5array8list_add,9rnonlocal21op_non_local_return_v,5rhash14op_hash_find_v,5prims4blob20json_skip_whitespace,5prims5array9array_new,4step4slow,4step9step_cold,4step9slow_body" if IDF_TARGET_ESP32 && TOIT_VERIFIED_CORE_LOOP_IN_IRAM
        # Targets with unified SRAM (C6, S3): every hot function outside
        # the loop (12 KB of heap on the C6).
        default "9rnonlocal8op_try_v,toit_v2_run,4room15ensure_room_all,7rarrays15cxx_primitive_v,7machine3run,5prims5array8list_add,9rnonlocal21op_non_local_return_v,5rhash14op_hash_find_v,5prims4blob20json_skip_whitespace,5prims5array9array_new,4step4slow,4step9slow_body,5rhash7probe_x,5rhash7hf_at_x,7rarrays18cxx_primitive_rest,9rnonlocal15unwind_resume_v,5prims4blob8blob_arg,6arraysNtNtB4_4exec7Machine9large_loc,5callsNtNtB4_4exec7Machine9do_return" if TOIT_VERIFIED_CORE_LOOP_IN_IRAM
        default ""
        depends on TOIT_VERIFIED_CORE
        help
            A comma-separated list of functions of the core's library to
            place in IRAM besides the loop, each given by the end of its
            mangled name: a C name (toit_v2_run) or the v0-mangled path in
            the crate (5rhash14op_hash_find_v for rhash::op_hash_find_v).
            A name that no longer exists only gives a build warning. The
            defaults are the hot functions outside the loop found by PC
            sampling on the boards (TOIT_HW_PERF): on the classic ESP32 they
            took 25-38 % of the busy time of service calls and json from
            flash; docs/format2-migration.md, "Devices: hardware results".

    config TOIT_TRACE_INSTALL
        bool "Trace install-time verifications (for measurements)"
        default n
        depends on TOIT_VERIFIED_CORE
        select HEAP_USE_HOOKS
        help
            Prints the time, the free heap and the peak heap use of every
            install-time verification of an untrusted container
            ("[install-trace]" lines on the console).

    config TOIT_VERIFIED_CORE_INFER
        bool "Link the certificate inference (for measurements)"
        default n
        depends on TOIT_VERIFIED_CORE
        help
            Devices verify untrusted programs with the certificate shipped in
            the image (verified/spec/format/18-shipped-certificate.md) and
            reject programs without one. This links the host's inference
            too (23-40 KB of flash); only useful to measure its size.

    config TOIT_VERIFIED_CORE_CHECKED_LOOP
        bool "Link the checked run loop (for measurements)"
        default n
        depends on TOIT_VERIFIED_CORE
        help
            The checked loop runs format-2 programs the verifier did not
            accept under the checked rules. Devices run untrusted programs
            only after the install-time verification and trusted
            (first-party) programs on the verified loop (the trusted token),
            so they do not need it; only useful to measure its size.

    config TOIT_HW_PERF
        bool "Cycle and performance counters per VM activity (for measurements)"
        default n
        help
            Counts the cycles (and on Xtensa the retired instructions and one
            stall or exception counter of the core's performance monitor)
            spent running processes, in primitives, in the GC, in the
            scheduler and idle, per core and per primitive (src/hw_perf.h).
            Profiler.start without an installed profiler resets the
            counters, Profiler.stop prints them ("[hw-perf]" lines). Costs
            some 50-100 cycles per primitive call and IRAM.
endmenu
```
