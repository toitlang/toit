// Copyright (C) 2026 Toit contributors.
// Generated by tools/ec618/check-base-api.toit --write.
// Reviewed source: toolchains/ec618/base-api.json.

EC618_BASE_API(ADC_disableVrefOutput)
EC618_BASE_API(ADC_enableVrefOutput)
EC618_BASE_API(BSP_QSPI_Cfg_Gran_Size)
EC618_BASE_API(BSP_QSPI_Reg_Operation_Cb)
EC618_BASE_API(CLOCK_bclkEnable)
EC618_BASE_API(CLOCK_fracDivOutCLkEnable)
EC618_BASE_API(CLOCK_fracDivOutClkDisable)
EC618_BASE_API(CLOCK_mclkDisable)
EC618_BASE_API(CLOCK_mclkEnable)
EC618_BASE_API(CLOCK_setBclkDiv)
EC618_BASE_API(CLOCK_setBclkSrc)
EC618_BASE_API(CLOCK_setFracDivConfig)
EC618_BASE_API(CLOCK_setFracDivOutClkDiv)
EC618_BASE_API(CLOCK_setMclkDiv)
EC618_BASE_API(CLOCK_setMclkSrc)
EC618_BASE_API(CLOCK_updateClockTreeElement)
EC618_BASE_API(CPXIP_Enable)
EC618_BASE_API(CPXIP_QSPI_Erase_Sector)
EC618_BASE_API(CPXIP_QSPI_Read)
EC618_BASE_API(CPXIP_QSPI_Write)
EC618_BASE_API(DMA_buildDescriptorChain)
EC618_BASE_API(DMA_getEnabledInterrupts)
EC618_BASE_API(DisableICache)
EC618_BASE_API(Driver_LPUSART1)
EC618_BASE_API(EnableICache)
EC618_BASE_API(GPIO_driverDeInit)
EC618_BASE_API(GPIO_restoreIrqMask)
EC618_BASE_API(GPIO_saveAndSetIrqMask)
EC618_BASE_API(GPR_apGetRstSrc)
EC618_BASE_API(HAL_ADC_ConvertThermalRawCodeToTemperature)
EC618_BASE_API(HAL_ADC_GetThermalTemperature)
EC618_BASE_API(HAL_ADC_SampleVbatVoltage)
EC618_BASE_API(HAL_Get_ChipID)
EC618_BASE_API(HAL_I2SGetTotalNum)
EC618_BASE_API(HAL_I2SSetPlayRecord)
EC618_BASE_API(HAL_I2SSetTotalNum)
EC618_BASE_API(HAL_I2sConfig)
EC618_BASE_API(HAL_I2sInit)
EC618_BASE_API(HAL_I2sSrcAdjustVolumn)
EC618_BASE_API(HAL_I2sStartSop)
EC618_BASE_API(HAL_I2sTransfer)
EC618_BASE_API(HAL_i2sSetSampleRate)
EC618_BASE_API(IC_Powoff)
EC618_BASE_API(IC_PowupInit)
EC618_BASE_API(IsICacheEnabled)
EC618_BASE_API(KPC_deInit)
EC618_BASE_API(KPC_getDefaultConfig)
EC618_BASE_API(KPC_init)
EC618_BASE_API(KPC_startScan)
EC618_BASE_API(KPC_stopScan)
EC618_BASE_API(PAD_driverDeInit)
EC618_BASE_API(PAD_enablePinInputBuffer)
EC618_BASE_API(PAD_setPinConfigWhenInit)
EC618_BASE_API(PAD_setPinMux)
EC618_BASE_API(TIMER_getCount)
EC618_BASE_API(TIMER_getInterruptConfig)
EC618_BASE_API(TIMER_netlightEnable)
EC618_BASE_API(TIMER_setInitValue)
EC618_BASE_API(TIMER_setMatch)
EC618_BASE_API(TIMER_setReloadOption)
EC618_BASE_API(TIMER_setupPwm)
EC618_BASE_API(TIMER_updatePwmDutyCycle)
EC618_BASE_API(UART_printf)
EC618_BASE_API(UART_purgeRx)
EC618_BASE_API(Uart_BaseInitEx)
EC618_BASE_API(Uart_ChangeBR)
EC618_BASE_API(Uart_RxBufferCB)
EC618_BASE_API(Uart_TxTaskSafe)
EC618_BASE_API(WDT_getDefaultConfig)
EC618_BASE_API(WDT_getInterruptFlags)
EC618_BASE_API(WDT_getMode)
EC618_BASE_API(WDTclearInterruptFlags)
EC618_BASE_API(XIC_BackupIRQSetting)
EC618_BASE_API(XIC_ClearAllPendingIRQ)
EC618_BASE_API(XIC_ClearPendingIRQ)
EC618_BASE_API(XIC_DisableAllIRQExceptUart)
EC618_BASE_API(XIC_DisableIRQ)
EC618_BASE_API(XIC_LatchIRQ)
EC618_BASE_API(XIC_RestoreAllIRQ)
EC618_BASE_API(XIC_RestoreIRQSetting)
EC618_BASE_API(XIC_SetPendingIRQ)
EC618_BASE_API(XIC_SuppressOvfIRQ)
EC618_BASE_API(aesUpdate)
EC618_BASE_API(alarmFuncInit)
EC618_BASE_API(alarmThmDisableInAdc)
EC618_BASE_API(alarmThmEnableInAdc)
EC618_BASE_API(alarmThmGetIntIndicate)
EC618_BASE_API(alarmThmHwDeinit)
EC618_BASE_API(alarmThmHwInit)
EC618_BASE_API(alarmVBatGetIntIndicate)
EC618_BASE_API(alarmVBatHwDeinit)
EC618_BASE_API(alarmVBatHwInit)
EC618_BASE_API(apmuBootDbgGPIOSet)
EC618_BASE_API(apmuGetLongSlpCfg)
EC618_BASE_API(apmuPeriCPPowerOnSetIrqMask)
EC618_BASE_API(apmuPeriCPPowerOnSetIrqRestore)
EC618_BASE_API(apmuPeriClearCPTimerInterrupt)
EC618_BASE_API(apmuPeriDeleteCPTimer)
EC618_BASE_API(apmuPeriDeleteWFITimer)
EC618_BASE_API(apmuPeriLpuartIsRxActive)
EC618_BASE_API(apmuPeriLpuartPreSleepProcess)
EC618_BASE_API(apmuPeriStartCPTimer)
EC618_BASE_API(apmuPeriStartWFITimer)
EC618_BASE_API(apmuPeriUsbEnterAbortProc)
EC618_BASE_API(apmuPeriUsbEnterStartProc)
EC618_BASE_API(apmuPeriUsbSleep1LateRecoverFlow)
EC618_BASE_API(apmuPeriUsbSleep1PreRecoverFlow)
EC618_BASE_API(apmuPeriUsbSusp2HibGuardDlyChk)
EC618_BASE_API(apmuPeriUsbSusp2VbusTblGuardDlyChk)
EC618_BASE_API(chargeDetectDeinit)
EC618_BASE_API(chargeDetectInit)
EC618_BASE_API(chargeGetCurStatus)
EC618_BASE_API(chargeHwDeinit)
EC618_BASE_API(chargeHwInit)
EC618_BASE_API(chargeIntHandler)
EC618_BASE_API(cpADCDeInit)
EC618_BASE_API(cpADCInit)
EC618_BASE_API(cpADCProxyStartChannel)
EC618_BASE_API(cspiDrvInterface1)
EC618_BASE_API(ecm0_sig_conn_info)
EC618_BASE_API(ecm0_sig_conn_stat)
EC618_BASE_API(i2sDrvInterface0)
EC618_BASE_API(owDeInit)
EC618_BASE_API(owInit)
EC618_BASE_API(owReadBit)
EC618_BASE_API(owReadByte)
EC618_BASE_API(owReset)
EC618_BASE_API(owResetPd)
EC618_BASE_API(owSetMode)
EC618_BASE_API(owTouchByte)
EC618_BASE_API(owWriteBit)
EC618_BASE_API(owWriteByte)
EC618_BASE_API(pwrKeyDeinit)
EC618_BASE_API(pwrKeyGetPinLevel)
EC618_BASE_API(pwrKeyHwDeinit)
EC618_BASE_API(pwrKeyHwInit)
EC618_BASE_API(pwrKeyInit)
EC618_BASE_API(pwrKeyPopKey)
EC618_BASE_API(pwrKeyPushKey)
EC618_BASE_API(pwrKeyStartPowerOff)
EC618_BASE_API(pwrkeyPwrOnDebounce)
EC618_BASE_API(rndis0_downlink_get_epnum)
EC618_BASE_API(rndis0_sig_conn_stat)
EC618_BASE_API(rndis0_sig_conn_test)
EC618_BASE_API(rndis0_uplink_get_epnum)
EC618_BASE_API(rndis0_uplink_xfer_cfg)
EC618_BASE_API(sctDeInit)
EC618_BASE_API(sctInit)
EC618_BASE_API(serial_vcom0_downlink_get_epnum)
EC618_BASE_API(serial_vcom0_uplink_get_epnum)
EC618_BASE_API(serial_vcom0_uplink_xfer_cfg)
EC618_BASE_API(serial_vcom1_downlink_get_epnum)
EC618_BASE_API(serial_vcom1_uplink_get_epnum)
EC618_BASE_API(serial_vcom1_uplink_xfer_cfg)
EC618_BASE_API(serial_vcom2_downlink_get_epnum)
EC618_BASE_API(serial_vcom2_uplink_get_epnum)
EC618_BASE_API(serial_vcom2_uplink_xfer_cfg)
EC618_BASE_API(shaUpdate)
EC618_BASE_API(slpManAPPGetAONFlag1)
EC618_BASE_API(slpManAPPGetAONFlag2)
EC618_BASE_API(slpManAPPSetAONFlag1)
EC618_BASE_API(slpManAPPSetAONFlag2)
EC618_BASE_API(slpManCheckVoteState)
EC618_BASE_API(slpManDeepSlpTimerIsRunning)
EC618_BASE_API(slpManDeepSlpTimerRemainMs)
EC618_BASE_API(slpManFindPlatVoteHandle)
EC618_BASE_API(slpManForceIOPowerState)
EC618_BASE_API(slpManGet6P25HZGlobalCnt)
EC618_BASE_API(slpManGetCPVoteStatus)
EC618_BASE_API(slpManGetCPWakeupFlag)
EC618_BASE_API(slpManGetChargePinValue)
EC618_BASE_API(slpManGetCurSlowCnt)
EC618_BASE_API(slpManGetCurrentPmuTimingCfg)
EC618_BASE_API(slpManGetEstimateSlpTime)
EC618_BASE_API(slpManGetIOSelPin)
EC618_BASE_API(slpManGetPlatBitmap)
EC618_BASE_API(slpManGetPwrkeyPinValue)
EC618_BASE_API(slpManGetRawFlashEraseCnt)
EC618_BASE_API(slpManGetSleepTime)
EC618_BASE_API(slpManGetVoteInfo)
EC618_BASE_API(slpManGetWakeupSlowCnt)
EC618_BASE_API(slpManIsLocalTimePrecise)
EC618_BASE_API(slpManNormalIOVoltGet)
EC618_BASE_API(slpManNormalIOVoltSet)
EC618_BASE_API(slpManNormalIoPowerCtrl)
EC618_BASE_API(slpManPlatVoteForceEnableSleep)
EC618_BASE_API(slpManPmuTimingChangedReq)
EC618_BASE_API(slpManRegisterPmuTimingCb)
EC618_BASE_API(slpManRegisterUsrSlpDepthCb)
EC618_BASE_API(slpManRegisterUsrdefinedBackupCb)
EC618_BASE_API(slpManRegisterUsrdefinedRestoreCb)
EC618_BASE_API(slpManSavePmuTimingCfg)
EC618_BASE_API(slpManSetCPSleepEnable)
EC618_BASE_API(slpManSetSleepLimitTime)
EC618_BASE_API(slpManSetWakeupIOPowerState)
EC618_BASE_API(slpManStartWaitATTimer)
EC618_BASE_API(slpManUnregisterPmuTimingCb)
EC618_BASE_API(slpManUnregisterUsrdefinedBackupCb)
EC618_BASE_API(slpManUnregisterUsrdefinedRestoreCb)
EC618_BASE_API(slpManUsim1LatchEn)
EC618_BASE_API(slpManWaitATTimerSet)
EC618_BASE_API(swLogDump)
EC618_BASE_API(swLogDumpPolling)
EC618_BASE_API(swLogExcep)
EC618_BASE_API(swLogPrintf)
EC618_BASE_API(swLogPrintfPolling)
EC618_BASE_API(uniLogFlushOut)
EC618_BASE_API(uniLogForceOut)
EC618_BASE_API(uniLogGetDumpRdyFlag)
EC618_BASE_API(uniLogGetPherType)
EC618_BASE_API(uniLogIsInitialized)
EC618_BASE_API(uniLogModuleAllowAllTraces)
EC618_BASE_API(uniLogModuleAllowTraces)
EC618_BASE_API(uniLogModuleDisableAllTraces)
EC618_BASE_API(uniLogModuleDisableTraces)
EC618_BASE_API(uniLogSetPherType)
EC618_BASE_API(uniLogStop)
EC618_BASE_API(uniLogStopHwLog)
EC618_BASE_API(uniLogTraceAllowCheck)
EC618_BASE_API(unilogSwitch2UartLog)
EC618_BASE_API(unilogSwitch2UsbLog)
EC618_BASE_API(usbDevNotifyRndisEvent)
EC618_BASE_API(usbcustom_multidev_ccinfo_map)
EC618_BASE_API(usbcustom_multidev_cfg_end)
EC618_BASE_API(usbcustom_multidev_cfg_reset)
EC618_BASE_API(usbcustom_multidev_cfg_update)
EC618_BASE_API(usbcustom_multidev_cmndesc)
EC618_BASE_API(usbcustom_multidev_ctrl_proc)
EC618_BASE_API(usbcustom_multidev_strdesc)
EC618_BASE_API(usbd_multi_lib_cmndesc_cb)
EC618_BASE_API(usbd_multi_lib_strdesc_cb)
EC618_BASE_API(usbd_multi_libcall_cmndesc)
EC618_BASE_API(usbd_multi_libcall_strdesc)
