## toolchains/esp32c3/sdkconfig.defaults
```kconfig
# CONFIG_APP_COMPILE_TIME_DATE is not set
CONFIG_BOOTLOADER_LOG_LEVEL_NONE=y
CONFIG_BOOTLOADER_APP_ROLLBACK_ENABLE=y
CONFIG_BOOTLOADER_SKIP_VALIDATE_IN_DEEP_SLEEP=y
CONFIG_ESPTOOLPY_FLASHSIZE_4MB=y
CONFIG_PARTITION_TABLE_CUSTOM=y
CONFIG_COMPILER_OPTIMIZATION_SIZE=y
CONFIG_COMPILER_OPTIMIZATION_ASSERTIONS_DISABLE=y
CONFIG_BT_ENABLED=y
CONFIG_BT_NIMBLE_ENABLED=y
CONFIG_BT_NIMBLE_MEM_ALLOC_MODE_DEFAULT=y
CONFIG_BT_NIMBLE_LOG_LEVEL_NONE=y
CONFIG_BT_NIMBLE_MAX_CONNECTIONS=2
CONFIG_BT_NIMBLE_MAX_BONDS=1
CONFIG_BT_NIMBLE_MAX_CCCDS=3
# CONFIG_BT_NIMBLE_ROLE_PERIPHERAL is not set
# CONFIG_BT_NIMBLE_NVS_PERSIST is not set
CONFIG_BT_NIMBLE_SVC_GAP_DEVICE_NAME="toit"
CONFIG_BT_NIMBLE_SVC_GAP_APPEARANCE=0x0
CONFIG_BT_NIMBLE_ACL_BUF_COUNT=10
# CONFIG_SPI_SLAVE_ISR_IN_IRAM is not set
CONFIG_UART_ISR_IN_IRAM=y
# CONFIG_ESP_ERR_TO_NAME_LOOKUP is not set
CONFIG_ETH_SPI_ETHERNET_DM9051=y
CONFIG_ETH_SPI_ETHERNET_W5500=y
# CONFIG_ESP_HTTP_CLIENT_ENABLE_HTTPS is not set
CONFIG_ESP_IPC_TASK_STACK_SIZE=1024
# CONFIG_ESP_NETIF_TCPIP_ADAPTER_COMPATIBLE_LAYER is not set
# CONFIG_ESP_PHY_CALIBRATION_AND_DATA_STORAGE is not set
# CONFIG_ESP_INT_WDT is not set
# CONFIG_ESP_TASK_WDT is not set
# CONFIG_ESP32_WIFI_NVS_ENABLED is not set
# CONFIG_FMB_CONTROLLER_SLAVE_ID_SUPPORT is not set
CONFIG_FMB_TIMER_PORT_ENABLED=y
CONFIG_FREERTOS_THREAD_LOCAL_STORAGE_POINTERS=3
CONFIG_FREERTOS_IDLE_TASK_STACKSIZE=1024
CONFIG_FREERTOS_ISR_STACKSIZE=2096
CONFIG_FREERTOS_USE_TRACE_FACILITY=y
CONFIG_FREERTOS_PLACE_FUNCTIONS_INTO_FLASH=y
CONFIG_LOG_DEFAULT_LEVEL_ERROR=y
# CONFIG_LOG_COLORS is not set
CONFIG_LWIP_LOCAL_HOSTNAME="toit"
# CONFIG_LWIP_DNS_SUPPORT_MDNS_QUERIES is not set
CONFIG_LWIP_ETHARP_TRUST_IP_MAC=y
CONFIG_LWIP_TCP_SYNMAXRTX=6
CONFIG_LWIP_TCP_MSS=1410
CONFIG_LWIP_TCP_SND_BUF_DEFAULT=5640
CONFIG_LWIP_TCP_WND_DEFAULT=5640
CONFIG_LWIP_TCPIP_TASK_STACK_SIZE=2560
CONFIG_MBEDTLS_SSL_IN_CONTENT_LEN=8100
CONFIG_MBEDTLS_SSL_OUT_CONTENT_LEN=3700
# CONFIG_MBEDTLS_HARDWARE_MPI is not set
CONFIG_MBEDTLS_TLS_CLIENT_ONLY=y
# CONFIG_MBEDTLS_SSL_PROTO_TLS1 is not set
# CONFIG_MBEDTLS_SSL_PROTO_TLS1_1 is not set
CONFIG_MBEDTLS_SSL_PROTO_DTLS=n
CONFIG_MBEDTLS_POLY1305_C=y
CONFIG_MBEDTLS_CHACHA20_C=y
CONFIG_MBEDTLS_CHACHAPOLY_C=y
# CONFIG_MQTT_PROTOCOL_311 is not set
# CONFIG_MQTT_TRANSPORT_SSL is not set
# CONFIG_MQTT_TRANSPORT_WEBSOCKET is not set
CONFIG_OPENSSL_ASSERT_DO_NOTHING=y
CONFIG_PTHREAD_TASK_STACK_SIZE_DEFAULT=2048
CONFIG_SPI_FLASH_VERIFY_WRITE=y
CONFIG_SPI_FLASH_LOG_FAILED_WRITE=y
CONFIG_SPI_FLASH_WARN_SETTING_ZERO_TO_ONE=y
# CONFIG_WIFI_PROV_BLE_BONDING is not set
```

## toolchains/idf/components/toit/Kconfig
```kconfig
menu "Toit"
    config TOIT_WIFI_SSID
        string "WiFi SSID"
        default ""
        depends on TOIT_ENABLE_WIFI
        help
            SSID (network name) for the example to connect to.

    config TOIT_WIFI_PASSWORD
        string "WiFi Password"
        default ""
        depends on TOIT_ENABLE_WIFI
        help
            WiFi password (WPA or WPA2) for the example to use.

    config TOIT_ENTRY_POINT
        string "Entry point"
        default ""
        help
            The toit entry point of custom toit program, for example examples/hello.toit.

    config TOIT_ENTRY_POINT_PROJECT_ROOT
        string "Entry point project root"
        default ""
        help
            Project root of the entry point toit program, if it includes external packages this is needed.

    config TOIT_ENTRY_POINT_ASSETS_FILE
        string "Entry point assets"
        default ""
        help
            An optional assets file to add to the entry point. The file is assumed to be named with an extension of json
            and the base name of the file becomes the name of the assets. The asset will be encoded as ubjson.
            As an example 'config.json' would become the config asset.

    config TOIT_BYTE_DISPLAY
        bool "Include primitives for byte-oriented (true-color or 256-shade gray) displays"
        default "y"

    config TOIT_BIT_DISPLAY
        bool "Include primitives for bit-oriented (2-color, 3-color, 4-shades) displays"
        default "y"

    config TOIT_FONT
        bool "Include primitives for font rendering"
        default "y"
        help
            If selected the font rendering primitives will be included in the
            Toit binary.  If this is selected you would normally want to also
            select either TOIT_BYTE_DISPLAY or TOIT_BIT_DISPLAY, otherwise you
            can only query font metrics, but not actually render characters.

    config TOIT_FATFS
        bool "Include primitives for the FAT filesystem"
        default "y"
        help
            If selected, embedded platforms will include the FAT filesystem
            primitives.

    config TOIT_ZLIB_RLE
        bool "Include primitives for zlib run-length encoding in native code"
        default "y"
        help
            If selected, embedded platforms will include code for run-length
            encoding.  It is available with `import zlib show
            RunLengthZlibEncoder`.

            This option takes about 1600 bytes of flash on ESP32 Xtensa.

    config TOIT_FULL_ZLIB
        bool "Include primitives for zlib compression/decompression in native code"
        default "n"
        help
            If selected, embedded platforms will include code for compressing
            and decompressing.  It is based on the MiniZ library.  It is
            available with `import zlib show Encoder Decoder`.

            Note that decompressing needs a contiguous
            32k buffer, so for systems without SPIRAM this is unlikely to work
            well.

            This option takes about 16k of flash on ESP32 Xtensa.

            As an alternative there is a pure Toit implementation of zlib
            decompression in the Toit standard library.  Use
            `import zlib show BufferingInflater CopyingInflater` to get
            access to this implementation.  The pure Toit version is slower,
            but always available, and does not suffer from fragmentation
            issues when allocating buffer space.

            There are also simple Toit implementations of zlib compression.
            These do not deliver large compression, but generate data streams
            compatible with zlib compression, eg for browsers that insist on
            getting zlib compressed data.

            Use `import zlib show UncompressedZlibEncoder` to
            get access to the uncompressed zlib-compatible encoder.

            Use `import zlib show RunLengthZlibEncoder` to
            get access to a zlib-compatible encoder that does only run-length
            encoding. This requires the TOIT_ZLIB_RLE option to be selected.

    config TOIT_REPORT_UART_DATA_LOSS
        bool "Report when UART data is lost"
        default "y"
        help
            If selected, the UART driver will report when data is lost due to
            the UART buffer being full.

            This slows down the UART driver slightly when it is already under
            pressure and has no purpose if the device's serial part is not
            monitored.

    menu "Advanced setup"
        config TOIT_INTERPRETER_IN_IRAM
            bool "Run interpreter from IRAM"
            default "y"
            help
                If selected, the interpreter will be placed in IRAM. This will
                increase the performance dramatically, but reduce the amount of
                free IRAM by about 13k.  Set to "n" if you cannot link because
                of exhausted IRAM.

        config TOIT_INTERPRETER_HELPERS_IN_IRAM
            bool "Run interpreter helper code from IRAM"
            default "y"
            help
                If selected, the interpreter helper functions will be placed in
                IRAM. This will increase the performance slightly, but reduce
                the amount of free IRAM by about 2k.  Set to "n" if you cannot
                link because of exhausted IRAM.

        config TOIT_CRYPTO
            boolean "Enable crypto functions on ESP32"
            default "y"
            help
                This includes certificate and TLS support.

        config TOIT_CRYPTO_EXTRA
            boolean "Enable extra crypto functions on ESP32"
            default "n"
            help
                This includes crypto and checksum algorithms that are not
                needed for TLS.

        config TOIT_ENABLE_IP
            boolean "Enable IP stack on ESP32"
            default "y"
            help
                IP support from the toit binary.

        config TOIT_ENABLE_ETHERNET
            boolean "Enable Ethernet drivers on ESP32"
            default "y"
            depends on TOIT_ENABLE_IP
            help
                Ethernet support in the toit binary.

        config TOIT_ENABLE_WIFI
            boolean "Enable WIFI on ESP32"
            default "y"
            depends on TOIT_ENABLE_IP
            help
                WIFI support in the Toit binary.

        config TOIT_ENABLE_ESPNOW
            boolean "Enable ESP-Now on ESP32"
            default "y"
            help
                ESP-Now support in the Toit binary.

        config TOIT_SPIRAM_HEAP
            boolean "Enable Toit heap in SPIRAM"
            default "y"
            depends on SPIRAM_USE_CAPS_ALLOC || SPIRAM_USE_MALLOC
            help
                Enables the possibility of allocating Toit heap in the SPIRAM.

        config TOIT_SYSTEM_SOURCE
            string "Toit source file for system"
            default "system/extensions/esp32/boot.toit"
            help
                The Toit source file used to compile the system snapshot. The system is responsible for bringing up
                basic Toit services. The file should be absolute, relative to the project dir or relative to
                the Toit root dir (resolved in that order).

        config TOIT_SYSTEM_SOURCE_PROJECT_ROOT
            string "Project root for system source"
            default "system"
            help
                The project root for the system source file.

        config RODATA_PADDING
            int "Add this much padding to the drom/rodata section before the MMU starts moving data around"
            default 2097152
            range 0 8388609
            help
                Adds padding to the DROM data, so that there is a gap between the end of the DROM and the start of
                bss/data sections. This enables the DROM to be rewritten by an outside entity, as long as the DROM
                section does not increase more than this padding.

    endmenu
endmenu
```
